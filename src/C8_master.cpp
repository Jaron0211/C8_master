/*
  Author: Jian Lun, Lee
  Date: 2023/09/10
  Version: 1.0.0
  Platform: ESP32-AIOT AirBox

  CAUTION:
  THIS CODE IS ONLY FOR TEST PURPOSE, DON'T USE IN COMMERCIAL.
*/

#include <C8_master.h>
#include <Arduino.h>


C8_master::~C8_master(){
    if(C8_Serial != NULL) free(C8_master::C8_Serial);
}

void C8_master::init(int baudrate)
{
  C8_master::C8_Serial = new SoftwareSerial(C8_master::com_port_tx,C8_master::com_port_rx);
  C8_master::C8_Serial -> begin(baudrate);
}

float C8_master::ActiveReadCO2() {

    float return_int[1];
    int raw_data[16];
    int CO2_index = -1;

    for ( int i = 0; i < sizeof(C8_master::send_command); i++){
        C8_master::C8_Serial -> write(C8_master::send_command[i]);
    }

    delay(10);

    String _buffer = "";
    while(C8_master::C8_Serial -> available()){
        char _buf = C8_master::C8_Serial -> read();
        _buffer += _buf;
    }

    if(sizeof(raw_data) > 0){
        CO2_index = raw_data[4] << 8 | raw_data[5];
    }

    C8_master::C8_Serial -> flush();

    return CO2_index;

}

float C8_master::ReadCO2() {

    String _buffer;
    int raw_data[16];
    int CO2_index = -1;

    if (C8_master::C8_Serial -> available() >= 16 && (millis() - C8_master::timer > 600)) {
        C8_master::timer = millis();
        while(C8_master::C8_Serial -> available()){
            char _buf = C8_master::C8_Serial -> read();
            _buffer += _buf;
        }

        if(sizeof(_buffer) > 0 ){
            
            //Issue #1 https://github.com/Jaron0211/C8_master/issues/1#issue-1931603183
            String _head_str = "";
            _head_str += char(0x42);
            _head_str += char(0x4D);
            _head_str += char(0x0C);
            _head_str += char(0x51);
            int header_index = _buffer.indexOf(_head_str);

            if (sizeof(_buffer) - header_index >= 16 ){
                for (int index = header_index; index < (16+header_index); index++){
                    raw_data[index-header_index] = _buffer[index];
                }
            }

            if(sizeof(raw_data) > 0){
                CO2_index = raw_data[6] << 8 | raw_data[7];
            }
            C8_master::C8_Serial -> flush();
        }
    }
    return CO2_index;

}

uint16_t C8_master::CRC16(uint8_t *dataarray, uint16_t datalen)
{
    uint8_t uchCRCHi = 0xFF ; 
    uint8_t uchCRCLo = 0xFF ;
    uint16_t uIndex ;
    uint16_t crc;
    const uint8_t auchCRCHi[] = {
        0x00, 0xC1, 0x81, 0x40, 0x01, 0xC0, 0x80, 0x41, 0x01, 0xC0, 0x80, 0x41, 0x00, 0xC1, 0x81,
        0x40, 0x01, 0xC0, 0x80, 0x41, 0x00, 0xC1, 0x81, 0x40, 0x00, 0xC1, 0x81, 0x40, 0x01, 0xC0,
        0x80, 0x41, 0x01, 0xC0, 0x80, 0x41, 0x00, 0xC1, 0x81, 0x40, 0x00, 0xC1, 0x81, 0x40, 0x01,
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        0x00, 0xC1, 0x81, 0x40, 0x01, 0xC0, 0x80, 0x41, 0x01, 0xC0, 0x80, 0x41, 0x00, 0xC1, 0x81,
        0x40
    };
    const uint8_t auchCRCLo[] = {
        0x00, 0xC0, 0xC1, 0x01, 0xC3, 0x03, 0x02, 0xC2, 0xC6, 0x06, 0x07, 0xC7, 0x05, 0xC5, 0xC4,
        0x04, 0xCC, 0x0C, 0x0D, 0xCD, 0x0F, 0xCF, 0xCE, 0x0E, 0x0A, 0xCA, 0xCB, 0x0B, 0xC9, 0x09,
        0x08, 0xC8, 0xD8, 0x18, 0x19, 0xD9, 0x1B, 0xDB, 0xDA, 0x1A, 0x1E, 0xDE, 0xDF, 0x1F, 0xDD,
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        0x44, 0x84, 0x85, 0x45, 0x87, 0x47, 0x46, 0x86, 0x82, 0x42, 0x43, 0x83, 0x41, 0x81, 0x80,
        0x40
    };

    while (datalen--)
    {
        uIndex = uchCRCLo ^ *dataarray++;
        uchCRCLo = uchCRCHi ^ auchCRCHi[uIndex];
        uchCRCHi = auchCRCLo[uIndex];
    }
    crc = (uint16_t)uchCRCHi *256;
    crc += (uint16_t)uchCRCLo;
    return crc;
}
